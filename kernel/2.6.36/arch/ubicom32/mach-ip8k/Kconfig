## kernel/2.6.36/arch/ubicom32/mach-ip8k/Kconfig
```kconfig
config IP8000RGW
	bool "IP8000RGW"
	select UBICOM32_V5
	select UBICOM32_IP8K_SHUTTLE
	select NEW_LEDS
	select LEDS_CLASS
	select LEDS_GPIO
	select PCIEPORTBUS if PCI
	select ARCH_SUPPORTS_MSI if PCI
	select PCI_MSI if PCI
	help
		Ubicom IP8000 BringUp, supports:
			8008-0010 v1.0 IP8K Bringup Board

config IP8100RGW
	bool "IP8100RGW"
	select UBICOM32_V5
	select UBICOM_INPUT
	select NEW_LEDS
	select LEDS_CLASS
	select LEDS_GPIO
	select SPI
	select SPI_UBICOM32_GPIO
	select I2C
	select I2C_GPIO
	select AT24
	select GPIO_PCA953X
	select MTD_UBI32_FC
	select MTD_UBI32_NAND_SPI_ER
	select UBICOM32_MULTI_FLASH
	select UBICOM32_LCD_ADAPTER if FB
	select PCIEPORTBUS if PCI
	select ARCH_SUPPORTS_MSI if PCI
	select PCI_MSI if PCI
	select PCI_DOMAINS if PCI
	select FB_UBICOM32 if FB
	select TOUCHSCREEN_TSC2007 if INPUT_TOUCHSCREEN
	select LCD_CLASS_DEVICE
	select LCD_UBICOM32POWER
	select VDC_LCD_SYNC
	select VDC_LCD_BITBANG_16
	help
		Ubicom IP8100 Router Gateway Eval, supports:
			8008-0111 v1.1  IP8K RGW Board
			8008-0112 v1.2  IP8K RGW Board
			8008-0310 v1.0  IP8K RGW Cost-effective 4-layer Board
```
